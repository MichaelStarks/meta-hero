## conf/layer.conf
```bitbake
# We have a conf and classes directory, add to BBPATH
BBPATH .= ":${LAYERDIR}"

# We have recipes-* directories, add to BBFILES
BBFILES += "${LAYERDIR}/recipes-*/*/*.bb ${LAYERDIR}/recipes-*/*/*.bbappend"

BBFILE_COLLECTIONS += "hero"
BBFILE_PATTERN_hero = "^${LAYERDIR}/"
BBFILE_PRIORITY_hero = "7"

# This should only be incremented on significant changes that will
# cause compatibility issues with other layers
LAYERVERSION_hero = "1"

# Add to this to include ros
LAYERDEPENDS_hero = "core"

LAYERSERIES_COMPAT_hero = "scarthgap"
```

## conf/machine/raspberrypi0-2w-64-hero.conf
```bitbake
require conf/machine/raspberrypi0-2w-64.conf

# Ensure the UART is enabled
RPI_EXTRA_CONFIG += "enable_uart=1\n"
RPI_EXTRA_CONFIG += "dtoverlay=disable-bt\n"
RPI_EXTRA_CONFIG += "dtoverlay=uart0\n"
DISTRO_FEATURES:remove = "bluetooth"
ENABLE_I2C = "1"
KERNEL_MODULE_AUTOLOAD:rpi += "i2c-dev i2c-bcm2708"
```
